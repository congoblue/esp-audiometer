## main/Kconfig.projbuild
```kconfig
menu "Sound Level Meter"

    config SLM_MIC_GAIN_DB
        int "ES7210 microphone PGA gain (dB)"
        range 0 37
        default 12
        help
            Analog gain applied by the ES7210 before the ADC (3 dB steps
            are typical; the driver picks the nearest step). Lower gain
            raises the maximum measurable level, higher gain lowers the
            noise floor. Calibration is stored relative to 0 dB gain, so
            changing this does not require recalibrating.

    config SLM_CAL_OFFSET_X10
        int "Default calibration offset at 0 dB gain (tenths of a dB)"
        default 1350
        help
            dB SPL = dBFS(RMS) - PGA gain + offset. The default (135.0 dB)
            is an estimate for a -38 dBV/Pa MEMS microphone; calibrate
            against a reference meter or 94 dB calibrator using the on-screen
            Cal page, which saves the result to NVS and overrides this value.

    menu "Auto-rotation"

        config SLM_AUTO_ROTATE
            bool "Rotate the display to follow the device (QMI8658 IMU)"
            default y

        config SLM_IMU_ROTATION_OFFSET
            int "Orientation offset (quarter turns clockwise)"
            depends on SLM_AUTO_ROTATE
            range 0 3
            default 3
            help
                Added to the detected orientation. 3 (= 90 degrees
                anticlockwise) is the default orientation for this device.
                It is also used when the board is lying flat at power-up or
                the IMU is not found. Change this if the display is always
                off by the same angle.

        config SLM_TOUCH_ROTATION_OFFSET
            int "Touch correction (quarter turns clockwise)"
            depends on SLM_AUTO_ROTATE
            range 0 3
            default 1
            help
                Rotates touch points relative to the picture. Use this when
                taps register a quarter or half turn away from where the
                button is drawn, by the same amount in every orientation.
                1 corrects touch that is rotated 90 degrees anticlockwise
                from the picture (tapping the top of the screen acts on the
                right). If that makes it worse, use 3.

        config SLM_IMU_MIRROR
            bool "Mirror IMU X axis"
            depends on SLM_AUTO_ROTATE
            default n
            help
                Enable if upright and upside-down work, but on either side the
                picture is upside down AND the buttons still respond where
                they are drawn. (The IMU picked the wrong side.)

        config SLM_PANEL_SWAP_90_270
            bool "Swap panel 90/270 rotation"
            depends on SLM_AUTO_ROTATE
            default n
            help
                Enable if upright and upside-down work, but on either side the
                picture is upside down AND tapping a button triggers the one
                drawn opposite it. (The panel rotates the opposite way to the
                BSP's MADCTL table.)

    endmenu

endmenu
```
